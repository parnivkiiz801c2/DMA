	INCLUDE				STM32F4xx.s
	
	AREA		SRAM1,		NOINIT,			READWRITE
	SPACE		0x400
Stack_Top
	
	AREA		RESET,		DATA,		READONLY
	DCD			Stack_Top				;[0x000-0x003]
	DCD			Start_Init				;[0x004-0x007]
	SPACE		0xCC					;[0x008-0x0D3]
	DCD			USART1_IRQHandler		;[0x0D4-0x0D7]
	
	AREA		PROGRAM,	CODE,		READONLY
	ENTRY

Start_Init
;Uses USART1: TX = PB6, RX = PB7 (AF7)
	LDR			R0,			=RCC_BASE
;USART1 CLK Enable
	LDR			R1,			[R0,		#RCC_APB2ENR]
	ORR			R1,			R1,			#RCC_APB2ENR_USART1EN
	STR			R1,			[R0,		#RCC_APB2ENR]
;GPIOA CLK Enable
	LDR			R1,			[R0,		#RCC_AHB1ENR]
	ORR			R1,			R1,			#RCC_AHB1ENR_GPIOBEN
	STR			R1,			[R0,		#RCC_AHB1ENR]
;PB6  = USART1_TX (AF7) | PB7 = USART1_RX (AF7)
	LDR			R0,			=GPIOB_BASE
	LDR			R1,			[R0,		#GPIO_MODER]
	BFC			R1,			#GPIO_MODER_MODER6_Pos,		#4
	ORR			R1,			R1,			#(GPIO_MODER_MODER7_1 + GPIO_MODER_MODER6_1)
	STR			R1,			[R0,		#GPIO_MODER]
;PB6 Pull Up | PB7 Pull Up
	LDR			R1,			[R0,		#GPIO_PUPDR]
	BFC			R1,			#GPIO_PUPDR_PUPD6_Pos,		#4
	ORR			R1,			R1,			#(GPIO_PUPDR_PUPD7_0 + GPIO_PUPDR_PUPD6_0)
	STR			R1,			[R0,		#GPIO_PUPDR]
	LDR			R1,			[R0,		#GPIO_AFRL]
	BFC			R1,			#GPIO_AFRL_AFSEL6_Pos,		#8
	ORR			R1,			R1,			#(7 << GPIO_AFRL_AFSEL6_Pos)
	ORR			R1,			R1,			#(7 << GPIO_AFRL_AFSEL7_Pos)
	STR			R1,			[R0,		#GPIO_AFRL]
;USART1 BR = 57 600, 2 stop bits, no parity
	LDR			R0,			=USART1_BASE
;F_APB2 = 16 MHz
;BRR = (16 MHz -  (57 600 / 2)) / 57 600 = 277
	MOV			R1,			#277
	STR			R1,			[R0,		#USART_BRR]
	LDR			R1,			[R0,		#USART_CR2]
	AND			R1,			R1,			#~USART_CR2_STOP
	ORR			R1,			R1,			#USART_CR2_STOP_1
	STR			R1,			[R0,		#USART_CR2]
	LDR			R1,			[R0,		#USART_CR1]
	ORR			R1,			R1,			#(USART_CR1_RE + USART_CR1_TE)
	ORR			R1,			R1,			#(USART_CR1_RXNEIE + USART_CR1_TCIE)
	ORR			R1,			R1,			#USART_CR1_UE
	STR			R1,			[R0,		#USART_CR1]
;USART1 Interrupts Enable
	LDR			R0,			=NVIC_BASE
	LDR			R1,			[R0,		#NVIC_ISER1]
	ORR			R1,			R1,			#(1 << (USART2_IRQn - 32))
	STR			R1,			[R0,		#NVIC_ISER1]
;	\|/
Main_Loop
	B			Main_Loop

USART1_IRQHandler
	LDR			R0,			=USART1_BASE
	LDR			R1,			[R0,		#USART_SR]
;Check TC
	AND			R2,			R1,			#USART_SR_TC
	CMP			R2,			#USART_SR_TC
	BEQ			USART1_IRQHandler_TC
;Check RXNE
	AND			R2,			R1,			#USART_SR_RXNE
	CMP			R2,			#USART_SR_RXNE
	BEQ			USART1_IRQHandler_RXNE
;Check ORE
	AND			R2,			R1,			#USART_SR_ORE
	CMP			R2,			#USART_SR_ORE
	BEQ			USART1_IRQHandler_ORE
	BX			LR

USART1_IRQHandler_TC
	AND			R1,			R1,			#~USART_SR_TC
	STR			R1,			[R0,		#USART_SR]
	BX			LR

USART1_IRQHandler_RXNE
	LDR			R1,			[R0,		#USART_DR]
	STR			R1,			[R0,		#USART_DR]
	BX			LR

USART1_IRQHandler_ORE
	BX			LR
	
	END